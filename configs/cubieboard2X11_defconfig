## configs/cubieboard2X11_defconfig
```kconfig
BR2_arm=y
BR2_cortex_a7=y
BR2_JLEVEL=7
BR2_KERNEL_HEADERS_VERSION=y
BR2_DEFAULT_KERNEL_VERSION="3.4.86"
BR2_PACKAGE_HOST_LINUX_HEADERS_CUSTOM_3_4=y
BR2_TOOLCHAIN_BUILDROOT_EGLIBC=y
BR2_TOOLCHAIN_BUILDROOT_CXX=y
BR2_ENABLE_LOCALE_PURGE=y
BR2_TARGET_GENERIC_HOSTNAME="Cubieboard2"
BR2_TARGET_GENERIC_ISSUE="Welcome to use Cubieboard!"
BR2_ROOTFS_DEVICE_CREATION_DYNAMIC_EUDEV=y
BR2_ROOTFS_POST_IMAGE_SCRIPT="board/cubietech/cubieboard/post-build.sh"
BR2_LINUX_KERNEL=y
BR2_LINUX_KERNEL_CUSTOM_GIT=y
BR2_LINUX_KERNEL_CUSTOM_REPO_URL="https://github.com/linux-sunxi/linux-sunxi.git"
BR2_LINUX_KERNEL_CUSTOM_REPO_VERSION="sunxi-v3.4.86-r0"
BR2_LINUX_KERNEL_USE_CUSTOM_CONFIG=y
BR2_LINUX_KERNEL_CUSTOM_CONFIG_FILE="board/cubietech/cubieboard/linux-cubieboard2.config"
BR2_PACKAGE_BUSYBOX_SHOW_OTHERS=y
BR2_PACKAGE_ALSA_UTILS=y
BR2_PACKAGE_XBMC=y
BR2_PACKAGE_XBMC_LIBCEC=y
BR2_PACKAGE_SUNXI_TOOLS=y
BR2_PACKAGE_FBSET=y
BR2_PACKAGE_MESA3D=y
BR2_PACKAGE_MESA3D_GALLIUM_DRIVER_SWRAST=y
BR2_PACKAGE_MESA3D_DRI_DRIVER_SWRAST=y
BR2_PACKAGE_MESA3D_OPENGL_EGL=y
BR2_PACKAGE_MESA3D_OPENGL_ES=y
BR2_PACKAGE_SDL_GFX=y
BR2_PACKAGE_XORG7=y
BR2_PACKAGE_XSERVER_XORG_SERVER=y
BR2_PACKAGE_XSERVER_XORG_SERVER_MODULAR=y
BR2_PACKAGE_XSERVER_XORG_SERVER_AIGLX=y
BR2_PACKAGE_XAPP_XINIT=y
BR2_PACKAGE_XAPP_XSETMODE=y
BR2_PACKAGE_XDRIVER_XF86_INPUT_EVDEV=y
BR2_PACKAGE_XDRIVER_XF86_INPUT_JOYSTICK=y
BR2_PACKAGE_XDRIVER_XF86_INPUT_KEYBOARD=y
BR2_PACKAGE_XDRIVER_XF86_INPUT_MOUSE=y
BR2_PACKAGE_XDRIVER_XF86_VIDEO_FBTURBO=y
BR2_PACKAGE_XTERM=y
BR2_PACKAGE_SUNXI_BOARDS=y
BR2_PACKAGE_SUNXI_BOARDS_FEX_FILE="a20/cubieboard2.fex"
BR2_PACKAGE_A10DISP=y
BR2_PACKAGE_DBUS=y
BR2_PACKAGE_DBUS_GLIB=y
BR2_PACKAGE_EUDEV_RULES_GEN=y
BR2_PACKAGE_SUNXI_CEDARX=y
BR2_PACKAGE_SUNXI_MALI=y
BR2_PACKAGE_SUNXI_MALI_DBG=y
BR2_PACKAGE_USBMOUNT=y
BR2_PACKAGE_GNUTLS=y
BR2_PACKAGE_MTDEV=y
BR2_PACKAGE_TSLIB=y
BR2_PACKAGE_LIBNL=y
BR2_PACKAGE_DHCP=y
BR2_PACKAGE_DHCP_CLIENT=y
BR2_PACKAGE_DROPBEAR=y
BR2_PACKAGE_TRANSMISSION=y
BR2_PACKAGE_TRANSMISSION_DAEMON=y
BR2_PACKAGE_VIM=y
BR2_TARGET_UBOOT=y
BR2_TARGET_UBOOT_BOARDNAME="cubieboard2"
BR2_TARGET_UBOOT_CUSTOM_GIT=y
BR2_TARGET_UBOOT_CUSTOM_REPO_URL="https://github.com/linux-sunxi/u-boot-sunxi.git"
BR2_TARGET_UBOOT_CUSTOM_REPO_VERSION="b4bca5e0651b460a4511582f07a935cb48f74948"
BR2_TARGET_UBOOT_SPL=y
BR2_TARGET_UBOOT_SPL_NAME="u-boot-sunxi-with-spl.bin"
BR2_PACKAGE_HOST_UBOOT_TOOLS=y
```

## configs/cubieboard2_xbmc_defconfig
```kconfig
BR2_arm=y
BR2_cortex_a7=y
BR2_TOOLCHAIN_EXTERNAL=y
BR2_TARGET_GENERIC_HOSTNAME="Cubieboard2"
BR2_TARGET_GENERIC_ISSUE="Welcome to use Cubieboard!"
BR2_ROOTFS_POST_IMAGE_SCRIPT="board/cubietech/cubieboard/post-build.sh"
BR2_LINUX_KERNEL=y
BR2_LINUX_KERNEL_CUSTOM_GIT=y
BR2_LINUX_KERNEL_CUSTOM_GIT_REPO_URL="https://github.com/linux-sunxi/linux-sunxi.git"
BR2_LINUX_KERNEL_CUSTOM_GIT_VERSION="5dda5145c877335e17bd9ca48954841acc0f785a"
BR2_LINUX_KERNEL_USE_CUSTOM_CONFIG=y
BR2_LINUX_KERNEL_CUSTOM_CONFIG_FILE="board/cubietech/cubieboard/linux-cubieboard2.config"
BR2_PACKAGE_FLAC=y
BR2_PACKAGE_VORBIS_TOOLS=y
BR2_PACKAGE_XBMC=y
BR2_PACKAGE_XBMC_LIBSAMPLERATE=y
BR2_PACKAGE_XBMC_VORBIS=y
BR2_PACKAGE_SDL=y
BR2_PACKAGE_SUNXI_TOOLS=y
BR2_PACKAGE_SUNXI_BOARDS=y
BR2_PACKAGE_SUNXI_BOARDS_FEX_FILE="a20/cubieboard2.fex"
BR2_PACKAGE_SUNXI_CEDARX=y
BR2_PACKAGE_SUNXI_MALI=y
BR2_TARGET_UBOOT=y
BR2_TARGET_UBOOT_BOARDNAME="cubieboard2"
BR2_TARGET_UBOOT_CUSTOM_GIT=y
BR2_TARGET_UBOOT_CUSTOM_GIT_REPO_URL="https://github.com/linux-sunxi/u-boot-sunxi.git"
BR2_TARGET_UBOOT_CUSTOM_GIT_VERSION="b4bca5e0651b460a4511582f07a935cb48f74948"
BR2_TARGET_UBOOT_SPL=y
BR2_TARGET_UBOOT_SPL_NAME="u-boot-sunxi-with-spl.bin"
BR2_PACKAGE_HOST_UBOOT_TOOLS=y
```

## package/tinyxml/Config.in
```kconfig
config BR2_PACKAGE_TINYXML
	bool "tinyxml"
        depends on BR2_INSTALL_LIBSTDCPP
	help
	  TinyXML is a simple, small, C++ XML parser that can be easily integrating into
	  other programs.

	  https://github.com/leethomason/tinyxml2

comment "tinyxml requires C++ support in toolchain"
        depends on !BR2_INSTALL_LIBSTDCPP
	
```

## package/xbmc/Config.in
```kconfig
config BR2_PACKAGE_XBMC
	bool "xbmc"
	select BR2_PACKAGE_BOOST
	select BR2_PACKAGE_BOOST_THREAD
	select BR2_PACKAGE_BZIP2
	select BR2_PACKAGE_EXPAT
	select BR2_PACKAGE_FRIBIDI
	select BR2_PACKAGE_JASPER
	select BR2_PACKAGE_LIBCDIO
	select BR2_PACKAGE_LIBCURL
	select BR2_PACKAGE_LIBGCRYPT
	select BR2_PACKAGE_LIBMODPLUG
	select BR2_PACKAGE_LIBMPEG2
	select BR2_PACKAGE_LIBPNG
	select BR2_PACKAGE_LIBUNGIF
	select BR2_PACKAGE_LZO
	select BR2_PACKAGE_OPENSSL
	select BR2_PACKAGE_PCRE
	select BR2_PACKAGE_PYTHON
	select BR2_PACKAGE_PYTHON_BSDDB
	select BR2_PACKAGE_PYTHON_BZIP2
	select BR2_PACKAGE_PYTHON_CURSES
	select BR2_PACKAGE_PYTHON_PYEXPAT
	select BR2_PACKAGE_PYTHON_READLINE
	select BR2_PACKAGE_PYTHON_SQLITE
	select BR2_PACKAGE_PYTHON_SSL
	select BR2_PACKAGE_PYTHON_UNICODEDATA
	select BR2_PACKAGE_PYTHON_ZLIB
	select BR2_PACKAGE_READLINE
	select BR2_PACKAGE_SQLITE
	select BR2_PACKAGE_TAGLIB
	select BR2_PACKAGE_TIFF
	select BR2_PACKAGE_TINYXML
	select BR2_PACKAGE_YAJL
	select BR2_PACKAGE_ZLIB
	depends on BR2_INSTALL_LIBSTDCPP
	depends on BR2_USE_WCHAR
	help
	  XBMC is an award-winning free and open source (GPL) software media
	  player and entertainment hub for digital media.

          http://xbmc.org

if BR2_PACKAGE_XBMC

menu "XBMC Plugins"
config BR2_PACKAGE_XBMC_AVAHI
        bool "avahi"
        select BR2_PACKAGE_AVAHI
        select BR2_PACKAGE_AVAHI_DAEMON
        help
          Enable Avahi support.
          Select this if you want XBMC to support Bonjour protocol.

config BR2_PACKAGE_XBMC_DBUS
	bool "dbus"
	select BR2_PACKAGE_DBUS
	help
          Enable DBUS support

config BR2_PACKAGE_XBMC_FLAC
	bool "flac"
	select BR2_PACKAGE_FLAC
	help
	  Enable flac input/streaming support.
	  Select this if you want to play back FLAC files.

config BR2_PACKAGE_XBMC_LIBASS
	bool "libass"
	select BR2_PACKAGE_LIBASS
	help
          Enable ASS sublititles support

config BR2_PACKAGE_XBMC_LIBBLURAY
        bool "libbluray"
        select BR2_PACKAGE_LIBBLURAY
        help
          Enable bluray input support.
          Select this if you want to play back bluray content.

config BR2_PACKAGE_XBMC_LIBCEC
        bool "libcec"
        select BR2_PACKAGE_LIBCEC
        help
          Enable CEC support.
          Select this if you want XBMC to support HDMI CEC.

config BR2_PACKAGE_XBMC_LIBMICROHTTPD
	bool "libmicrohttpd"
	select BR2_PACKAGE_LIBMICROHTTPD
	help
          Enable webserver feature

config BR2_PACKAGE_XBMC_LIBNFS
        bool "libnfs"
        select BR2_PACKAGE_LIBNFS
        help
          Enable NFS server support.

config BR2_PACKAGE_XBMC_LIBRTMP
        bool "librtmp"
        select BR2_PACKAGE_LIBRTMP
        help
          Enable rtmp input support.
          Select this if you want to play back rtmp stream.

config BR2_PACKAGE_XBMC_LIBSAMPLERATE
	bool "libsamplerate"
	select BR2_PACKAGE_LIBSAMPLERATE
	help
	  Enable libsamplerate input support.
	  Select this for software sample rate conversion.

config BR2_PACKAGE_XBMC_LIBSHAIRPORT
        bool "libshairport"
        select BR2_PACKAGE_LIBSHAIRPORT
        help
          Enable shairport support.
          Select this if you want to stream content from Apple device.

config BR2_PACKAGE_XBMC_LIBSMBCLIENT
	bool "libsmbclient"
	select BR2_PACKAGE_SAMBA
	select BR2_PACKAGE_LIBSMBCLIENT
	help
          Enable Samba support

config BR2_PACKAGE_XBMC_LIBTHEORA
	bool "libtheora"
	select BR2_PACKAGE_LIBTHEORA
	help
	  Enable theora input support.
	  Select this if you want to play back OGG/OGV files (Video).

config BR2_PACKAGE_XBMC_LIBUSB
	bool "libusb"
	depends on BR2_TOOLCHAIN_HAS_THREADS 
	select BR2_PACKAGE_LIBUSB
	select BR2_PACKAGE_LIBUSB_COMPAT
	help
	  Enable libusb support.

config BR2_PACKAGE_XBMC_MAD
	bool "mad"
	default y
	select BR2_PACKAGE_LIBID3TAG
	select BR2_PACKAGE_LIBMAD
	help
	  Enable mad input support.
	  Select this if you want to play back MP3 files.

config BR2_PACKAGE_XBMC_MYSQL_CLIENT
	bool "mysql"
	select BR2_PACKAGE_MYSQL_CLIENT
	help
          Enable MySQL support

config BR2_PACKAGE_XBMC_VORBIS
	bool "vorbis"
	select BR2_PACKAGE_LIBOGG
	select BR2_PACKAGE_LIBVORBIS
	help
	  Enable vorbis input/streaming support.
	  Select this if you want to play back OGG files on hardfloat targets.

config BR2_PACKAGE_XBMC_WAVPACK
	bool "wavpack"
	select BR2_PACKAGE_WAVPACK
	help
	  Enable wavpack input support.
	  Select this if you want to play back WV files.

endmenu

endif

comment "XBMC requires C++ support in toolchain"
	depends on !BR2_INSTALL_LIBSTDCPP

comment "XBMC requires WCHAR support in toolchain"
	depends on !BR2_USE_WCHAR
```
